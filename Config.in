## Config.in
```kconfig
#
# Copyright (C) 2006-2007 OpenWrt.org
# Copyright (C) 2010,2011 NDM Systems
#
# This is free software, licensed under the GNU General Public License v2.
# See /LICENSE for more information.
#

mainmenu "OpenWrt Configuration"

config HAVE_DOT_CONFIG
	bool
	default y

source "target/Config.in"

menu "Target Images"
	config TARGET_ROOTFS_INITRAMFS
		bool "ramdisk"
		default n
		depends LINUX_2_6
		help
		  Embed the rootfs into the kernel (initramfs)

	config TARGET_ROOTFS_JFFS2
		bool "jffs2"
		default y if USES_JFFS2
		depends !TARGET_ROOTFS_INITRAMFS
		help
		  Build a jffs2 root filesystem

	config TARGET_ROOTFS_SQUASHFS
		bool "squashfs"
		default y if USES_SQUASHFS
		depends !TARGET_ROOTFS_INITRAMFS
		help
		  Build a squashfs-lzma root filesystem

	config TARGET_ROOTFS_TGZ
		bool "tgz"
		default y if USES_TGZ
		depends !TARGET_ROOTFS_INITRAMFS
		help
		  Build a compressed tar archive of the the root filesystem
		  
	config TARGET_ROOTFS_CPIOGZ
		bool "cpiogz"
		default y if USES_CPIOGZ
		depends !TARGET_ROOTFS_INITRAMFS
		help
		  Build a compressed cpio archive of the the root filesystem
		  
	config TARGET_ROOTFS_EXT2FS
		bool "ext2"
		default y if USES_EXT2
		depends !TARGET_ROOTFS_INITRAMFS
		help
		  Ext2 file system with some free space for uml images

comment "Providers Options"

    config TARGET_PROVIDER
		string  "Provider name"
		default "null"

comment "Image Options"

    config TARGET_ROOTFS_FSPART
        int "Filesystem part size (in MB)"
        depends TARGET_ROOTFS_EXT2FS
        default 16
        help
            Allows you to change the filesystem partition size

    config TARGET_ROOTFS_MAXINODE
        int "Maximum number of inodes in filesystem"
        depends TARGET_ROOTFS_EXT2FS
        default 1500
        help
            Allows you to change the maximum number of inodes in the filesystem
    
    config TARGET_VERSION
	string  "Version name"
	default "V1.00(BWN.0)D0" if TARGET_keenetic_lite
	default "V1.00(BWO.0)D0" if TARGET_keenetic_4g
	default "V1.00(BFW.0)D0" if TARGET_keenetic

    config TARGET_DEVICE_NAME
	string  "Device name for the UI"
	default "KEENETIC" if TARGET_keenetic
	default "KEENETIC LITE" if TARGET_keenetic_lite
	default "KEENETIC 4G" if TARGET_keenetic_4g

    config TARGET_DEVICE_ID
        string "Device ID"
	default 0x4215 if TARGET_keenetic
	default 0x417 if TARGET_keenetic_lite
	default 0x4115 if TARGET_keenetic_4g

    config TARGET_WIRELESS
	bool "Enable Wireless functionality"
	default y
    
    config TARGET_KERNEL_SIZE
	string "The size of the kernel"
	default 0x130000 if TARGET_keenetic
	default 0xF0000 if TARGET_keenetic_lite || TARGET_keenetic_4g

    config TARGET_ROOTFS_SIZE
	string "The size of the rootfs"
	default 0x470000 if TARGET_keenetic
	default 0x2B0000 if TARGET_keenetic_lite || TARGET_keenetic_4g

    config TARGET_KERNEL_PATH
	string "The partition of the kernel"
	default /dev/mtdblock/3
	
    config TARGET_ROOTFS_PATH
	string "The partition of the root filesystem"
	default /dev/mtdblock/4

    config TARGET_FLASH_PATH
	string  "Path to flash device with settings for zycfg"
	default /dev/mtdblock/5

    config TARGET_DEV_CONSOLE
	string "The console device"
	default ttyS1

    config TARGET_WAN_IF
	string "The external network interface"
	default eth2.2
    
    config TARGET_PHY_IF
	string "The global network interface"
	default eth2
	
    config TARGET_LAN_IF
	string "The local network interface"
	default br0

    config TARGET_WLAN_IF
	string "The wireless network interface"
	default ra0

    config TARGET_WIMAX_IF
	string "The wimax network interface"
	default wimax0
endmenu

config ALL
	bool "Select all packages by default"
	default n

menuconfig DEVEL
	bool "Advanced configuration options (for developers)"
	default n
	select BUILDOPTS
	select TOOLCHAINOPTS if !NATIVE_TOOLCHAIN

config BROKEN
	bool
	prompt "Show broken platforms / packages" if DEVEL
	default n

config LOCALMIRROR
	string
	prompt "Local mirror for source packages" if DEVEL

menuconfig BUILDOPTS
	bool
	prompt "Build Options" if DEVEL

config CLEAN_IPKG
	bool
	prompt "Clean all ipkg files before building the rootfs" if BUILDOPTS
	default n

config AUTOREBUILD
	bool
	prompt "Automatic rebuild of packages" if BUILDOPTS
	default y
	help
		Automatically rebuild packages when their files change

config BUILD_SUFFIX
	string
	prompt "Build suffix to append to the BUILD_DIR variable" if BUILDOPTS
	default ""
	help
		Build suffix to append to the BUILD_DIR variable, i.e: build_dir_suffix

config TAR_VERBOSITY
	bool 
	prompt "Tar verbose" if BUILDOPTS
	default n

config CCACHE
	bool
	prompt "Use ccache" if BUILDOPTS
	default n
	help
		Compiler cache; see http://ccache.samba.org/

config EXTERNAL_KERNEL_TREE
	string
	prompt "Use external kernel tree" if DEVEL
	default ""


source "toolchain/Config.in"
menuconfig BUILDSYSTEM_SETTINGS
    bool "Buildsystem settings" 

config DOWNLOAD_FOLDER
	string
	prompt "Download folder"
	default ""
	depends BUILDSYSTEM_SETTINGS 
source "target/imagebuilder/Config.in"
source "target/sdk/Config.in"

source "tmp/.config-package.in"
```
